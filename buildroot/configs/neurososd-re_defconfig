## buildroot/package/OSD-re/Config.in
```kconfig
# This folder contains all Neuros OSD specific packages

source "package/OSD-re/closed-hwdrivers/Config.in"
source "package/OSD-re/closed-media/Config.in"

source "package/OSD-re/upk-builder/Config.in"
```

## buildroot/package/OSD-re/closed-hwdrivers/Config.in
```kconfig
menu "OSD Hardware Drivers - closed binaries"

config BR2_PACKAGE_OSDRE_CLOSED_HWDRIVERS_NEUROSRTC
        bool "MSP430 chip support - IR and clock driver"
        help
          Closed kernel module for the MSP430 chip, which enables IR send
          and receive support, and the real time clock.
        
config BR2_PACKAGE_OSDRE_CLOSED_HWDRIVERS_TVP5150
        bool "TVP5150 chip support - Video input controller chip driver"
        help
          Closed kernel module for the TVP5150 chip, which is a ADC which 
          converts the PAL/NTSC video input into CCD-style data for the DSP.

config BR2_PACKAGE_OSDRE_CLOSED_HWDRIVERS_AIC23
        bool "AIC23 - Audio chip driver"
        help
          Closed kernel module for the AIC23 chip, which inputs and outputs
          audio.

comment "Enable the PCM media codec driver for actual sound support"
        depends on BR2_PACKAGE_OSDRE_CLOSED_HWDRIVERS_AIC23

config BR2_PACKAGE_OSDRE_CLOSED_HWDRIVERS_ITFB
        bool "Framebuffer support"
        select BR2_PACKAGE_OSDRE_CLOSED_MEDIA_IMANAGE
        help
          Closed kernel module to enable the framebuffer at /dev/fb0

comment "The framebuffer requires the Imanage framework (auto-selected)"
        depends on BR2_PACKAGE_OSDRE_CLOSED_MEDIA_IMANAGE

endmenu
```

## buildroot/package/OSD-re/closed-media/Config.in
```kconfig
menu "OSD Media System (DSP-based) - closed binaries"

comment "Audio support"
config BR2_PACKAGE_OSDRE_CLOSED_MEDIA_PCM
        bool "PCM audio support"
        select BR2_PACKAGE_OSDRE_CLOSED_HWDRIVERS_AIC23
        help
          Enable ARM access to audio. Requires AIC23 chip.
comment "PCM audio requires the AIC23 chip driver which has been auto-selected"
        depends on BR2_PACKAGE_OSDRE_CLOSED_MEDIA_PCM

comment "Audio/Video Decoders"

config BR2_PACKAGE_OSDRE_CLOSED_MEDIA_DEC_MPEG2_PCM
        bool "DM320 MPEG2 + PCM Decoder"
        select BR2_PACKAGE_OSDRE_CLOSED_MEDIA_IMANAGE

config BR2_PACKAGE_OSDRE_CLOSED_MEDIA_DEC_MPEG4_PCM
        bool "DM320 MPEG4-SP + PCM Decoder"
        select BR2_PACKAGE_OSDRE_CLOSED_MEDIA_IMANAGE

config BR2_PACKAGE_OSDRE_CLOSED_MEDIA_DEC_MPEG4_G711
        bool "DM320 MPEG4 + G.711 + G.726 Decoder"
        select BR2_PACKAGE_OSDRE_CLOSED_MEDIA_IMANAGE

config BR2_PACKAGE_OSDRE_CLOSED_MEDIA_DEC_DIVX_PCM
        bool "DM320 DivX 3.11 + PCM Decoder"
        select BR2_PACKAGE_OSDRE_CLOSED_MEDIA_IMANAGE

config BR2_PACKAGE_OSDRE_CLOSED_MEDIA_DEC_WMV_WMA_PCM
        bool "DM320 WMV + WMA + PCM Decoder"
        select BR2_PACKAGE_OSDRE_CLOSED_MEDIA_IMANAGE

comment "***Following 3 Decoders require additional media frameworks (auto-selected for you)***"

config BR2_PACKAGE_OSDRE_CLOSED_MEDIA_DEC_DIVX
        bool "DIVX311 Video Decoder Codec Plugin"
        select BR2_PACKAGE_OSDRE_CLOSED_MEDIA_IDECODE

config BR2_PACKAGE_OSDRE_CLOSED_MEDIA_DEC_MPEG2
        bool "MPEG2 Video Decoder Codec Plugin"
        select BR2_PACKAGE_OSDRE_CLOSED_MEDIA_IDECODE

config BR2_PACKAGE_OSDRE_CLOSED_MEDIA_DEC_WMV
        bool "WMV Video Decoder Codec Plugin"
        select BR2_PACKAGE_OSDRE_CLOSED_MEDIA_IDECODE


comment "Audio/Video Encoders"

config BR2_PACKAGE_OSDRE_CLOSED_MEDIA_ENC_MPEG4_PCM
        bool "DM320 MPEG4 (QVGA+VGA) + PCM Encoders"
        select BR2_PACKAGE_OSDRE_CLOSED_MEDIA_IMANAGE

config BR2_PACKAGE_OSDRE_CLOSED_MEDIA_ENC_MPEG4_G711
        bool "DM320 MPEG4 (QVGA+VGA) + G.711 + G.726 Encoders"
        select BR2_PACKAGE_OSDRE_CLOSED_MEDIA_IMANAGE


comment "Video Encoders + Audio Encoder/Decoder"

config BR2_PACKAGE_OSDRE_CLOSED_MEDIA_ENCDEC_MPEG4_G711
        bool "DM320 MPEG4 Encoder + G.711 + G.726 Encoder/Decoder"
        select BR2_PACKAGE_OSDRE_CLOSED_MEDIA_IMANAGE


comment "Image Encoding/Decoding"

config BR2_PACKAGE_OSDRE_CLOSED_MEDIA_DEC_JPEG
        bool "DM320 JPEG Image Decoder"
        select BR2_PACKAGE_OSDRE_CLOSED_MEDIA_IMANAGE
        
config BR2_PACKAGE_OSDRE_CLOSED_MEDIA_ENC_JPEG
        bool "DM320 JPEG Image Encoder"
        select BR2_PACKAGE_OSDRE_CLOSED_MEDIA_IMANAGE

config BR2_PACKAGE_OSDRE_CLOSED_MEDIA_ENCDEC_JPEG
        bool "DM320 JPEG Image Encoder/Decoder"
        select BR2_PACKAGE_OSDRE_CLOSED_MEDIA_IMANAGE

config BR2_PACKAGE_OSDRE_CLOSED_MEDIA_DEC_JPEG_PCM
        bool "DM320 JPEG Image + PCM Decoder"
        depends on BR2_PACKAGE_OSDRE_CLOSED_HWDRIVERS_AIC23
        select BR2_PACKAGE_OSDRE_CLOSED_MEDIA_IMANAGE

comment "PCM audio requires the AIC23 chip driver"
        depends on !BR2_PACKAGE_OSDRE_CLOSED_MEDIA_AIC23

config BR2_PACKAGE_OSDRE_CLOSED_MEDIA_DEC_IMAGE
        bool "IMAGE Decode Plugin"
        select BR2_PACKAGE_OSDRE_CLOSED_MEDIA_IDECODE


comment "Core Frameworks (often autoselected by choices above)"

config BR2_PACKAGE_OSDRE_CLOSED_MEDIA_IMANAGE
        bool "imanage"
        help
          Closed kernel module with tools all Ingenient media modules use.

config BR2_PACKAGE_OSDRE_CLOSED_MEDIA_IVIDIO
        bool "ividio"
        select BR2_PACKAGE_OSDRE_CLOSED_MEDIA_IMANAGE
        help
          Closed kernel module for all video I/O, including PAL/NTSC control,
          Preview Engine, Video Capture and Window Display.

config BR2_PACKAGE_OSDRE_CLOSED_MEDIA_IDECODE
        bool "idecode"
        select BR2_PACKAGE_OSDRE_CLOSED_MEDIA_IVIDIO
        help
          Closed kernel module with tools many Ingenient media modules use
          to decode video for display.

config BR2_PACKAGE_OSDRE_CLOSED_MEDIA_IENCODE
        bool "iencode"
        select BR2_PACKAGE_OSDRE_CLOSED_MEDIA_IVIDIO
        help
          Closed kernel module with tools many Ingenient media modules use
          to encode video for storage.

endmenu
```

## buildroot/package/OSD-re/upk-builder/Config.in
```kconfig
config BR2_PACKAGE_OSDRE_UPK_BUILDER
       bool "upk-builder"
       help
         UPK files are used to update the firmware on the Neuros OSD.

	 https://github.com/gerboland/osd-upk-builder
```

## buildroot/package/e17/Config.in
```kconfig
menuconfig BR2_PACKAGE_E17
	bool "Enlightenment (E17)"
	select BR2_PACKAGE_XORG7
	help
	  Support for EFL libraries.

	  http://www.enlightenment.org/

if BR2_PACKAGE_E17

    menu "EFL components"
        source package/e17/eina/Config.in
        source package/e17/eet/Config.in
        source package/e17/evas/Config.in
        source package/e17/ecore/Config.in
        source package/e17/embryo/Config.in
        source package/e17/edje/Config.in
        source package/e17/e_dbus/Config.in
        source package/e17/efreet/Config.in
    endmenu

endif

comment "EFL requires a toolchain with WCHAR support"
        depends on !BR2_USE_WCHAR
```

## buildroot/package/e17/e_dbus/Config.in
```kconfig
config BR2_PACKAGE_EFL_E_DBUS
	bool "e_dbus"
	select BR2_PACKAGE_PKG_CONFIG
	select BR2_PACKAGE_QT_DBUS
	help
	  E_DBUS EFL library
```

## buildroot/package/e17/ecore/Config.in
```kconfig
config BR2_PACKAGE_EFL_ECORE
	bool "ecore"
	select BR2_PACKAGE_PKG_CONFIG
	select BR2_PACKAGE_XLIB_LIBX11
	select BR2_PACKAGE_LIBXCB
	select BR2_PACKAGE_XLIB_LIBXRANDR
	select BR2_PACKAGE_LIBGLIB2
	select BR2_PACKAGE_EFL_EINA
	select BR2_PACKAGE_EFL_EVAS
	help
	  ECORE EFL library

if BR2_PACKAGE_EFL_ECORE

config BR2_PACKAGE_EFL_ECORE_ENABLE-G-MAIN-LOOP
	bool "enable g-main-loop"
	help
	   Enable ecore_main_loop based on g_main_loop

endif
```

## buildroot/package/e17/edje/Config.in
```kconfig
config BR2_PACKAGE_EFL_EDJE
	bool "edje"
	select BR2_PACKAGE_PKG_CONFIG
	select BR2_PACKAGE_LUA
	select BR2_PACKAGE_LUA_SHARED_LIBRARY
	select BR2_PACKAGE_FONTCONFIG
	select BR2_PACKAGE_FREETYPE
	select BR2_PACKAGE_EFL_EINA
	select BR2_PACKAGE_EFL_EET
	select BR2_PACKAGE_EFL_EMBRYO
	select BR2_PACKAGE_EFL_ECORE
	help
	  EDJE EFL library


if BR2_PACKAGE_EFL_EDJE

config BR2_PACKAGE_EFL_EDJE_AMALGAMATION
	bool "edje amalgamation"
	help
	  Enable generation of one single file with all source
	  code in it, helps compiler optimizations.

endif
```

## buildroot/package/e17/eet/Config.in
```kconfig
config BR2_PACKAGE_EFL_EET
	bool "eet"
	select BR2_PACKAGE_PKG_CONFIG
        select BR2_PACKAGE_ZLIB 
	select BR2_PACKAGE_JPEG
	select BR2_PACKAGE_OPENSSL
	help
	  EET EFL library

if BR2_PACKAGE_EFL_EET

config BR2_PACKAGE_EFL_EET_TESTS
	bool "eet tests"
	help
	   EET EFL library enable tests

config BR2_PACKAGE_EFL_EET_EXAMPLES
	bool "eet examples"
	help
	   EET EFL library enable building examples

config BR2_PACKAGE_EFL_EET_COVERAGE
	bool "eet coverage"
	help
	   EET EFL library enable coverage profiling instrumentation

endif
```

## buildroot/package/e17/efreet/Config.in
```kconfig
config BR2_PACKAGE_EFL_EFREET
	bool "efreet"
	select BR2_PACKAGE_PKG_CONFIG
	select BR2_PACKAGE_EFL_EINA
	select BR2_PACKAGE_EFL_EET
	select BR2_PACKAGE_EFL_ECORE
	help
	  EFREET EFL library

if BR2_PACKAGE_EFL_EFREET

config BR2_PACKAGE_EFL_EFREET_TESTS
        bool "efreet tests"
        help
          Enable tests for EFREET EFL library

config BR2_PACKAGE_EFL_EFREET_COVERAGE
        bool "efreet coverage"
        help
          Enable coverage profiling instrumentation for EFREET EFL library

endif
```

## buildroot/package/e17/eina/Config.in
```kconfig
config BR2_PACKAGE_EFL_EINA
	bool "eina"
	select BR2_PACKAGE_PKG_CONFIG
	help
	  EINA EFL library

if BR2_PACKAGE_EFL_EINA

config BR2_PACKAGE_EFL_EINA_TESTS
	bool "eina tests"
	help
	   Enable EINA tests

config BR2_PACKAGE_EFL_EINA_COVERAGE
	bool "eina coverage"
	help
	   Enable EINA coverage profiling instrumentation

config BR2_PACKAGE_EFL_EINA_BENCHMARK
	bool "eina benchmark"
	help
	   Enable EINA benchmarking

endif
```

## buildroot/package/e17/embryo/Config.in
```kconfig
config BR2_PACKAGE_EFL_EMBRYO
	bool "embryo"
	select BR2_PACKAGE_PKG_CONFIG
	help
	  EMBRYO EFL library
```

## buildroot/package/e17/evas/Config.in
```kconfig
config BR2_PACKAGE_EFL_EVAS
	bool "evas"
	select BR2_PACKAGE_PKG_CONFIG
	select BR2_PACKAGE_FREETYPE
	select BR2_PACKAGE_EFL_EINA
        #select BR2_PACKAGE_LIBPNG
        #select BR2_PACKAGE_LIBRSVG
	#select BR2_PACKAGE_TIFF
	#select BR2_PACKAGE_JPEG
	#select BR2_PACKAGE_LIBUNGIF
	help
	  EVAS EFL library

if BR2_PACKAGE_EFL_EVAS

config BR2_PACKAGE_EFL_EVAS_EXAMPLES
	bool "evas examples"
	help
	  EVAS EFL library exmaples

endif
```

## kernel/linux-2.6.15-neuros-eabi/arch/arm/mach-davinci/Kconfig
```kconfig
if ARCH_DAVINCI

menu "TI DaVinci Implementations"

comment "DaVinci Core Type"

config ARCH_DAVINCI644x
	default y
	bool "DaVinci 644x based system"

comment "DaVinci Board Type"

config MACH_ITDM644X_10
	bool "Ingenient Technologies DM644X-10"
	default y
	depends on ARCH_DAVINCI644x
	help

config MACH_DAVINCI_EVM
	bool "TI DaVinci EVM"
	default n
	depends on ARCH_DAVINCI644x
	help
	  Configure this option to include support for DaVinci EVM

config MACH_DAVINCI_DVDP
	default n
	depends on ARCH_DAVINCI644x
	help
	  Obsolete machine type

# Legacy machine type 
config MACH_DAVINCI_DVDP
        bool
        depends on MACH_DAVINCI_EVM
        default y
        
config DAVINCI_I2C_EXPANDER
	bool "TI DaVinci I2C Expander"
	default y
	depends on ARCH_DAVINCI644x
	help
	  Configure this option to specify whether the board used
	  has I2C exapnder with ATA, USB, CF.

comment "DaVinci Options"

config DAVINCI_SYSCLK_FREQ
	int "TI DaVinci ARM Clock Frequency in KZ"
	default 229500
	help
	 Configure this option to set the initial running frequency of ARM.

config DAVINCI_MEMSIZE
	int "TI DaVinci Memory Size for Linux in MB"
	default 256
	help
	  Select this option to configure the memory available for Linux
	  on DaVinci EVM.

config DAVINCI_BLK_DEV_CF
	bool "TI DaVinci CF Card Support"
	default Y
	depends on BLK_DEV_DAVINCI
	help
	  Configure this option to enable CF Card support.

config DAVINCI_ENABLE_UART1
	bool "Enable UART1 support"
	depends on !BLK_DEV_IDEDMA_DAVINCI
	default n
	help
	    UART1 is pin-multiplexed with the IDE-DMA pins.
	    If your application needs IDE-DMA, say N.

config DAVINCI_ENABLE_UART2
	bool "Enable UART2 support"
	default y
	help
	    UART2 is pin-multiplexed with 16-bit video capture port.
	    16-bit video capture is only needed for HD applications.
	    If your video capture is not Hi Definition, you
	    may safely say Y here.
endmenu

endif
```

## kernel/linux-2.6.15-neuros-eabi/arch/arm/mach-davinci/spi/Kconfig
```kconfig
#
# Character device configuration
#

menu "SPI support"

config SPI
	tristate "SPI support"
	---help---
	  SPI is a slow serial bus protocol used in many micro controller 
          applications. 

	  If you want SPI support, you should say Y here and also to the
	  specific driver for your bus adapter(s) below.

	  This spi support can also be built as a module.  If so, the module
	  will be called spi-core.

config SPI_CHARDEV
	tristate "SPI device interface"
	depends on SPI
	help
	  Say Y here to use spi-* device files, usually found in the /dev
	  directory on your system.  They make it possible to have user-space
	  programs use the SPI bus.  Information on how to do this is
	  contained in the file <file:Documentation/sppi/dev-interface>.

	  This support is also available as a module.  If so, the module 
	  will be called spi-dev.

config SPI_DEBUG_CORE
	bool "SPI Core debugging messages"
	depends on SPI
	help
	  Say Y here if you want the SPI core to produce a bunch of debug
	  messages to the system log.  Select this if you are having a
	  problem with SPI support and want to see more of what is going on.

config SPI_DEBUG_ALGO
	bool "SPI Algorithm debugging messages"
	depends on SPI
	help
	  Say Y here if you want the SPI algorithm drivers to produce a bunch
	  of debug messages to the system log.  Select this if you are having
	  a problem with SPI support and want to see more of what is going
	  on.

config SPI_DEBUG_CHIP
	bool "SPI Chip debugging messages"
	depends on SPI
	help
	  Say Y here if you want the SPI chip drivers to produce a bunch of
	  debug messages to the system log.  Select this if you are having
	  a problem with SPI support and want to see more of what is going
	  on.

config SPI_DAVINCI
        tristate "DAVINCI SPI adapter"
        depends on SPI
        help
          Support for TI DaVinci SPI driver. Say yes if you want to use the DaVinci
          SPI interface.

config SPI_DAVINCI_TEST
        tristate "Sample Test case to test DAVINCI SPI adapter"
        depends on SPI_DAVINCI
endmenu
```

## kernel/linux-2.6.15-neuros-eabi/arch/arm/mach-itdm320-20/Kconfig
```kconfig
menu "Ingenient DMA Options"
	depends on ARCH_ITDM320_20 || ARCH_ITDM340_10

choice
	prompt "Device DMA Utilization"
	default DMA_NET

config DMA_NET
	bool "Network DMA"

config DMA_HDD
	bool "Hard-Disk DMA"
endchoice


endmenu
```

## kernel/linux-2.6.15-neuros-eabi/arch/arm/mach-ntosd-dm320/Kconfig
```kconfig
menu "Neuros DMA Options"
	depends on ARCH_NTOSD_DM320

choice
	prompt "Device DMA Utilization"
	default DMA_NET

config DMA_NET
	bool "Network DMA"

config DMA_HDD
	bool "Hard-Disk DMA"
endchoice

config INGENIENT_BSP
	bool
	default y

endmenu
```
