## kernel/linux-2.6.15-neuros-eabi/drivers/misc/Kconfig
```kconfig
#
# Misc strange devices
#

menu "Misc devices"

config IBM_ASM
	tristate "Device driver for IBM RSA service processor"
	depends on X86 && PCI && EXPERIMENTAL
	---help---
	  This option enables device driver support for in-band access to the
	  IBM RSA (Condor) service processor in eServer xSeries systems.
	  The ibmasm device driver allows user space application to access
	  ASM (Advanced Systems Management) functions on the service
	  processor. The driver is meant to be used in conjunction with
	  a user space API.
	  The ibmasm driver also enables the OS to use the UART on the
	  service processor board as a regular serial port. To make use of
	  this feature serial driver support (CONFIG_SERIAL_8250) must be
	  enabled.
	  
	  WARNING: This software may not be supported or function
	  correctly on your IBM server. Please consult the IBM ServerProven
	  website <http://www.pc.ibm.com/ww/eserver/xseries/serverproven> for
	  information on the specific driver level and support statement
	  for your IBM server.


	  If unsure, say N.

config NEUROS_GENERIC
	tristate "Neuros generic (multipurpose) driver"
	depends on ARCH_ITDM3XX
	---help---
	  This option enables a generic multipurpose driver intended for Neuros
	  products (mainly the OSD).

	  Currently, this driver includes support for setting the system clock
	  frequency via the on-chip PLL.

	  To compile this driver as a module (recommended), choose M here: the
	  module will be called neuros_generic.

	  If unsure and targeting the Neuros OSD, say M.
	  
config NEUROS_IR_BLASTER
	tristate "Neuros IR blaster driver"
	depends on ARCH_ITDM3XX
	---help---
	  This option enables the Neuros IR blaster driver.

	  TODO: This needs a better description.

	  To compile this driver as a module (recommended), choose M here: the
	  module will be called neuros_ir_blaster.

	  If unsure and targeting the Neuros OSD, say M.
	  
config XLOCK
	tristate "xlock driver"
	---help---
	  This option enables the xlock driver.

	  TODO: This needs a better description.

	  To compile this driver as a module (recommended), choose M here: the
	  module will be called xlock.

	  If unsure and targeting the Neuros OSD, say M.
	  
endmenu
```

## kernel/linux-2.6.15-neuros-eabi/drivers/net/arm/Kconfig
```kconfig
#
# Acorn Network device configuration
#  These are for Acorn's Expansion card network interfaces
#
config ARM_AM79C961A
	bool "ARM EBSA110 AM79C961A support"
	depends on NET_ETHERNET && ARM && ARCH_EBSA110
	select CRC32
	help
	  If you wish to compile a kernel for the EBSA-110, then you should
	  always answer Y to this.

config ARM_ETHER1
	tristate "Acorn Ether1 support"
	depends on NET_ETHERNET && ARM && ARCH_ACORN
	help
	  If you have an Acorn system with one of these (AKA25) network cards,
	  you should say Y to this option if you wish to use it with Linux.

config ARM_ETHER3
	tristate "Acorn/ANT Ether3 support"
	depends on NET_ETHERNET && ARM && ARCH_ACORN
	help
	  If you have an Acorn system with one of these network cards, you
	  should say Y to this option if you wish to use it with Linux.

config ARM_ETHERH
	tristate "I-cubed EtherH/ANT EtherM support"
	depends on NET_ETHERNET && ARM && ARCH_ACORN
	select CRC32
	help
	  If you have an Acorn system with one of these network cards, you
	  should say Y to this option if you wish to use it with Linux.

config ARM_ETHER00
	tristate "Altera Ether00 support"
	depends on NET_ETHERNET && ARM && ARCH_CAMELOT
	help
	  This is the driver for Altera's ether00 ethernet mac IP core. Say
	  Y here if you want to build support for this into the kernel. It
	  is also available as a module (say M here) that can be inserted/
	  removed from the kernel at the same time as the PLD is configured.
	  If this driver is running on an epxa10 development board then it
	  will generate a suitable hw address based on the board serial
	  number (MTD support is required for this). Otherwise you will
	  need to set a suitable hw address using ifconfig.

config SMC91X_INGENIENT
	tristate "SMC 91C9x/91C1xxx support -Ingenient"
	select CRC32
	select MII
	depends on ARM
	help
	  This is a driver for SMC's 91x series of Ethernet chipsets,
	  including the SMC91C94 and the SMC91C111. Say Y if you want it
	  compiled into the kernel, and read the file
	  <file:Documentation/networking/smc9.txt>  and the Ethernet-HOWTO,
	  available from  <http://www.linuxdoc.org/docs.html#howto>.

	  This driver is also available as a module ( = code which can be
	  inserted in and removed from the running kernel whenever you want).
	  The module will be called smc91x.  If you want to compile it as a
	  module, say M here and read <file:Documentation/modules.txt> as well
	  as <file:Documentation/networking/net-modules.txt>.

config SMC911X_INGENIENT
	tristate "SMC 911X support -Ingenient"
	select CRC32
	select MII
	depends on ARM
	help
	  This is a driver for SMC's 911x series of Ethernet chipsets,
          LAN911x refers to the following chips.
        	LAN9118
	        LAN9117
        	LAN9116
	        LAN9115
        	LAN9112

	  This driver is also available as a module ( = code which can be
	  inserted in and removed from the running kernel whenever you want).
	  The module will be called smc91x.  If you want to compile it as a
	  module, say M here and read <file:Documentation/modules.txt> as well
	  as <file:Documentation/networking/net-modules.txt>.
config DMA_NET_RX
	bool "SMC 911X RX DMA support -Ingenient"
	depends on SMC911X_INGENIENT || SMC91X_INGENIENT
	help
	   This option is used to select DMA for Rx operation
config DMA_NET_TX
	bool "SMC 911X TX DMA support -Ingenient"
	depends on SMC911X_INGENIENT || SMC91X_INGENIENT
	help
	   This option is used to select DMA for Tx operation

config DM9KS
	tristate "Davicom dm9ks support"
	select CRC32
	select MII
	depends on ARM
	help
	  This is a driver for Davicom's dm9ks of Ethernet chipsets,
	  including the dm9000A and the dm9010. Say Y if you want it
	  compiled into the kernel.

	  This driver is also available as a module ( = code which can be
	  inserted in and removed from the running kernel whenever you want).
	  The module will be called smc91x.  If you want to compile it as a
	  module, say M here.
```

## kernel/linux-2.6.15-neuros-eabi/drivers/usb/musb/Kconfig
```kconfig
#
# USB Dual Role (OTG-ready) Controller Drivers
# for silicon based on Mentor Graphics INVENTRA designs
#

comment "Enable Host or Gadget support to see Inventra options"
	depends on !USB && USB_GADGET=n

# (M)HDRC = (Multipoint) Highspeed Dual-Role Controller
config USB_MUSB_HDRC
	depends on USB || USB_GADGET
	tristate 'Inventra USB Highspeed Dual Role Controller Support'
	help
	  Say Y here if your system has a dual role high speed USB
	  controller based on the Mentor Graphics silicon IP.  Then
	  then configure options to match your silicon and the board
	  it's being used with, including the USB peripheral role,
	  or the USB host role, or both.

	  If you do not know what this is, please say N.

	  To compile this driver as a module, choose M here; the
	  module will be called "musb_hdrc".



choice
	prompt "Role"
	depends on USB_MUSB_HDRC 
	help
	  Dual-Role devices can support both host and peripheral roles,
	  as well as a the special "OTG Device" role which can switch
	  between both roles as needed.

# use USB_MUSB_HDRC_HCD not USB_MUSB_HOST to #ifdef host side support;
# OTG needs both roles, not just USB_MUSB_HOST.
config USB_MUSB_HOST
	depends on USB
	bool "USB Host"
	help
	  Say Y here if your system supports the USB host role.
	  If it has a USB "A" (rectangular), "Mini-A" (uncommon),
	  or "Mini-AB" connector, it supports the host role.
	  (With a "Mini-AB" connector, you should enable USB OTG.)

# use USB_GADGET_MUSB_HDRC not USB_MUSB_PERIPHERAL to #ifdef peripheral
# side support ... OTG needs both roles
config USB_MUSB_PERIPHERAL
	depends on USB_GADGET
	bool "USB Peripheral (gadget stack)"
	select USB_GADGET_MUSB_HDRC
	help
	  Say Y here if your system supports the USB peripheral role.
	  If it has a USB "B" (squarish), "Mini-B", or "Mini-AB"
	  connector, it supports the peripheral role.
	  (With a "Mini-AB" connector, you should enable USB OTG.)

config USB_MUSB_OTG
	depends on USB && USB_GADGET && EXPERIMENTAL && n
	bool "USB OTG (On The Go) Device"
	select USB_GADGET_MUSB_HDRC
	select USB_OTG
	help
	   The most notable feature of USB OTG is support for a
	   "Dual-Role" device, which can act as either a device
	   or a host.  The initial role choice can be changed
	   later, when two dual-role devices talk to each other.

	   Select this only if your system has a Mini-AB connector.

	   To implement your OTG Targeted Peripherals List (TPL), enable
	   USB_OTG_WHITELIST and update "drivers/usb/core/otg_whitelist.h"
	   to match your requirements.

endchoice

# enable peripheral support (including with OTG)
config USB_GADGET_MUSB_HDRC
	bool
	depends on USB_MUSB_HDRC && (USB_MUSB_PERIPHERAL || USB_MUSB_OTG)
#	default y
#	select USB_GADGET_DUALSPEED
#	select USB_GADGET_SELECTED

# enables host support (including with OTG)
config USB_MUSB_HDRC_HCD
	bool
	depends on USB_MUSB_HDRC && (USB_MUSB_HOST || USB_MUSB_OTG)
	select USB_OTG if USB_GADGET_MUSB_HDRC
	default y



# FIXME code is still not wholly consistent about how it chooses I/O ...

# REVISIT enable DMA later, after testing with both roles

config USB_INVENTRA_FIFO
	#bool 'Use PIO instead of DMA'
	bool
	depends on USB_MUSB_HDRC
	default y
	help
	  All data is copied between memory and FIFO by the CPU.
	  DMA controllers (from Mentor or otherwise) are ignored.

config USB_INVENTRA_DMA
	bool
	depends on USB_MUSB_HDRC && !USB_INVENTRA_FIFO
	depends on ARCH_OMAP
	default y
	help
	  Enable DMA transfers using Mentor's engine.

config USB_TI_CPPI_DMA
	bool
	depends on USB_MUSB_HDRC && !USB_INVENTRA_FIFO
	depends on ARCH_DAVINCI
	default y
	help
	  Enable DMA transfers when TI CPPI DMA is available.

config USB_INVENTRA_STATIC_CONFIG
	bool
	depends on USB_MUSB_HDRC
	default y
	help
	  Use a static <asm/arch/hdrc_cnf.h> file to describe how the
	  controller is configured (endpoints, mechanisms, etc).

config USB_INVENTRA_HCD_POLLING
	depends on USB_MUSB_HDRC && n
	bool 'Use polling driver (debug only)'
	default false
	help
	  Enable polling mode (events won't be triggered by IRQs);
	  may be useful for debugging.

	  If you do not know what this is, please say N.	  

config	USB_INVENTRA_HCD_LOGGING
	depends on USB_MUSB_HDRC
	int  'Logging Level (0 - none / 3 - annoying)'
	default 0 
	help
	  Set the logging level. 0 disables the debugging altogether,
	  although when USB_DEBUG is set the value is at least 1.
```

## kernel/linux-2.6.15-neuros-eabi/drivers/video/omap/Kconfig
```kconfig
config FB_OMAP
    tristate "OMAP frame buffer support (EXPERIMENTAL)"
        depends on FB
        help
          Frame buffer driver for OMAP based boards.

config FB_OMAP_LCDC_INTERNAL
    bool "Internal LCD controller support"
    depends on FB_OMAP
    help
      Say Y here, if you want to have support for the internal OMAP
      LCD controller.  Can only select internal TV controller support 
      or internal LCD controller support, not both.  If unsure, say Y.

config FB_OMAP_LCDC_SHARP01
    bool "LCD controller is SHARP01"
    depends on FB_OMAP_LCDC_INTERNAL && ARCH_OMAP2430
    help
      Say Y here, if you want to have support for SHARP 01.
      If unsure, say Y.

config FB_OMAP_LCDC_CASIO01
    bool "LCD controller is CASIO01"
    depends on FB_OMAP_LCDC_INTERNAL && ARCH_OMAP2430
    help
      Say Y here, if you want to have support for CASIO 01.
      If unsure, say N.

config FB_OMAP_TVC_INTERNAL
    bool "Internal TV controller support"
    depends on FB_OMAP
    help
      Say Y here, if you want to have support for the internal OMAP
      TV controller. Can only select internal TV controller support 
      or LCD internal controller support, not both.  If unsure, say N.

config FB_OMAP_TVC_PAL_BDGHI_PANEL
    bool "TV controller is PAL BDGHI"
    depends on FB_OMAP_TVC_INTERNAL && ARCH_OMAP2430
    help
      Say Y here, if you want to have support for TV PAL BDGHI.
      If unsure, say N.

config FB_OMAP_TVC_PAL_NC_PANEL
    bool "TV controller is PAL NC"
    depends on FB_OMAP_TVC_INTERNAL && ARCH_OMAP2430
    help
      Say Y here, if you want to have support for TV PAL NC.
      If unsure, say N.

config FB_OMAP_TVC_PAL_N_PANEL
    bool "TV controller is PAL N"
    depends on FB_OMAP_TVC_INTERNAL && ARCH_OMAP2430
    help
      Say Y here, if you want to have support for TV PAL N.
      If unsure, say N.

config FB_OMAP_TVC_PAL_M_PANEL
    bool "TV controller is PAL M"
    depends on FB_OMAP_TVC_INTERNAL && ARCH_OMAP2430
    help
      Say Y here, if you want to have support for TV PAL M.
      If unsure, say N.

config FB_OMAP_TVC_PAL_60_PANEL
    bool "TV controller is PAL 60"
    depends on FB_OMAP_TVC_INTERNAL && ARCH_OMAP2430
    help
      Say Y here, if you want to have support for TV PAL 60.
      If unsure, say N.

config FB_OMAP_TVC_NTSC_J_PANEL
    bool "TV controller is NTSC J"
    depends on FB_OMAP_TVC_INTERNAL && ARCH_OMAP2430
    help
      Say Y here, if you want to have support for TV NTSC J.
      If unsure, say N.

config FB_OMAP_TVC_NTSC_443_PANEL
    bool "TV controller is NTSC 443"
    depends on FB_OMAP_TVC_INTERNAL && ARCH_OMAP2430
    help
      Say Y here, if you want to have support for TV NTSC 443.
      If unsure, say N.

config FB_OMAP_TVC_NTSC_M_PANEL
    bool "TV controller is NTSC M"
    depends on FB_OMAP_TVC_INTERNAL && ARCH_OMAP2430
    help
      Say Y here, if you want to have support for TV NTSC M.
      If unsure, say Y.

config FB_OMAP_LCDC_EXTERNAL
    bool "External LCD controller support"
    depends on FB_OMAP
    help
      Say Y here, if you want to have support for boards with an
      external LCD controller connected to the SoSSI/RFBI interface. 

config FB_OMAP_MANUAL_UPDATE
    bool "Default to manual update mode"
    depends on FB_OMAP && FB_OMAP_LCDC_EXTERNAL
    help
      Say Y here, if your user-space applications are capable of
      notifying the frame buffer driver when a change has occured in
          the frame buffer content and thus a reload of the image data to
      the external frame buffer is required. If unsure, say N.

config FB_OMAP_DMA_TUNE
        bool "Set DMA SDRAM access priority high"
        depends on FB_OMAP && ARCH_OMAP1
        help
          On systems in which video memory is in system memory
          (SDRAM) this will speed up graphics DMA operations.
          If you have such a system and want to use rotation
          answer yes. Answer no if you have a dedicated video
          memory, or don't use any of the accelerated features.
```
